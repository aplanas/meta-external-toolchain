## conf/layer.conf
```bitbake
# We have a conf and classes directory, add to BBPATH
BBPATH .= ":${LAYERDIR}"

# We have recipes-* directories, add to BBFILES
BBFILES += "${LAYERDIR}/recipes-*/*/*.bb \
            ${LAYERDIR}/recipes-*/*/*.bbappend"

BBFILE_COLLECTIONS += "external-toolchain"
BBFILE_PATTERN_external-toolchain = "^${LAYERDIR}/"
BBFILE_PRIORITY_external-toolchain = "1"

LAYERDEPENDS_external-toolchain = "core"
LAYERSERIES_COMPAT_external-toolchain = "mickledore"

# Used to find the lib/ directory and import the Python code
LAYERDIR_external-toolchain = "${LAYERDIR}"

# These will rebuild when EXTERNAL_TOOLCHAIN changes, but we don't want
# everything to rebuild in such a case.
SIGGEN_EXCLUDERECIPES_ABISAFE += "\
    gcc-external-cross \
    gcc-external-cross-${TARGET_ARCH} \
    binutils-external-cross  \
    binutils-external-cross-${TARGET_ARCH} \
"

# Needed for external_run() for PV & LICENSE in the recipes, to be able to parse
INHERIT:append = " external_global"

# Fallback default for when the tcmode isn't sourced
GCC_VERSION ?= "0.0"
```
